/*
 * Allwinner Technology CO., Ltd. sun50iw10p1 soc board.
 *
 * soc board support.
 */

#include "sun50iw10p1-common-board.dts"

&platform {
	debug_mode  = <1>;
};

&fastboot_key {
	device_type = "fastboot_key";
	key_max = <42>;
	key_min = <38>;
};

&recovery_key {
	device_type = "recovery_key";
	key_max = <31>;
	key_min = <28>;
};
