## board/sunxi/Kconfig
```kconfig
menu "sunxi board feature"

config SUNXI_MAC
	bool "sunxi_mac"
	default n
	help
		when enabled, uboot read mac addr and send to system via cmdline

config SUNXI_USER_KEY
	bool "user key"
	default n
	select SUNXI_SECURE_STORAGE
	help
		when enable, uboot try to read cmdline data from secure storage

config SUNXI_DRM_SUPPORT
	bool "drm support"
	default n
	help
		when enable, uboot set up drm related configurate

config SUNXI_ADVERT_PICTURE
	bool "advert logo"
	default n
	depends on BOOT_GUI
	help
		when enable, uboot will try to use logo in reserve0, witch can be modified by APPS

menuconfig SUNXI_ANDROID_BOOT
	bool "android boot sequence"
	default n
	imply SUNXI_AVB
	help
		boot seqquence requeseted by AOSP: GREEN YELLOW ORANGE RED, etc

if SUNXI_ANDROID_BOOT
config LIBAVB
	bool "android avb support lib"
	default n
	help
		library for Android verified Boot

config SUNXI_AVB
	bool "sunxi support for android verify boot"
	default n
	select LIBAVB
	help
		support android verify boot sequence in sunxi board
endif

menuconfig SUNXI_HOMLET
	bool "sunxi homlet support"
	default n
	imply SUNXI_BOX_STANDBY
	help
		features for homle product

if SUNXI_HOMLET
config SUNXI_BOX_STANDBY
	bool "box standby"
	default n

config IR_BOOT_RECOVERY
	bool "support ir remote control"
	default n
	select SUNXI_IR

config SUNXI_HDCP_IN_SECURESTORAGE
	bool "hdcp key support"
	default n
	imply SUNXI_HDCP_HASH
	help
		support hdcp key

if SUNXI_HDCP_IN_SECURESTORAGE
config SUNXI_HDCP_HASH
	bool "hdcp key hash process"
	default n
	help
		store hdcp key hash for key usage

endif

endif

endmenu
```

## rtos/Kconfig
```kconfig
config SUNXI_FREERTOS
	bool "Sunxi Freertos support"
	default n
	help
	  Enable support for sunxi freertos

if SUNXI_FREERTOS
config SUNXI_FREERTOS_OFFSET1
	int "freertos offset 1"
	default 1024
	help
	  freertos offset1 is offset*512 bytes

config SUNXI_FREERTOS_OFFSET2
	int "freertos offset 2"
	default 5120
	help
	  free rtos offset2 is offset*512 bytes

config SUNXI_FREERTOS_LOGICAL_OFFSET
	int "freertos logical offset"
	default 10208
	help
	  spinor address is offset*512 bytes
endif
```
